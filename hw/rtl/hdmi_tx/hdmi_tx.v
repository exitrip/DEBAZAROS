// hdmi_tx.v - DVI/HDMI transmitter with audio, a replacement for Digilent
// rgb2dvi 1.4 as this design uses it (kGenerateSerialClk = false,
// kRstActiveHigh = false, no lane swaps). BD module reference.
//
// ctrl = 0: DVI. The TMDS output is the same as rgb2dvi's (same encoder, same
//   channel mapping, same serializer); only the latency is LOOK + 1 clocks longer
//   (sync and data together, so the picture does not move).
// ctrl[0] = 1: HDMI. Data islands in the horizontal blanking of every line:
//   the AVI InfoFrame (every field), and with ctrl[1] audio in ONE format,
//   48 kHz 2-ch 16-bit L-PCM: Audio Clock Regeneration, Audio Sample packets
//   and the Audio InfoFrame. The island position comes from the incoming timing (VTC), so
//   any video mode works: the block measures the line length and the active
//   width, and a LOOK-pixel delay line finds the start of each active line
//   for the video preamble and guard band.
//
// ctrl bits (quasi-static, any clock):
//   [0]    HDMI mode (0 = DVI)
//   [1]    audio packets
//   [2]    test tone: 1 kHz square, -24 dBFS, on the internal sample clock
//   [9:8]  AVI VIC: 0 = 4 (720p60), 1 = 34 (1080p30), 2 = 16 (1080p60), 3 = none
// fs_inc: internal 48 kHz sample clock, fs = fs_inc * f_pixel / 2^32 (0 = off;
//   720p60: 74.25 MHz -> fs_inc = 2776544).
// aud_l/aud_r/aud_valid: external samples, one strobe per stereo sample, in
//   the PixelClk domain (ignored while the test tone is on).
//
// Constant packets: hdmi_tx_rom.v, generated by gen_rom.py.
// Data islands, packets, ECC: ported from hdl-util/hdmi (c) 2019 Sameer Puri,
// MIT licence (LICENSE-hdl-util-MIT). Video encoder and serializer: same
// structure as Digilent rgb2dvi.
`timescale 1ns / 1ps
module hdmi_tx #(
    parameter LOOK = 10            // >= 10: video preamble (8) + guard (2)
) (
    output wire       TMDS_Clk_p,
    output wire       TMDS_Clk_n,
    output wire [2:0] TMDS_Data_p,
    output wire [2:0] TMDS_Data_n,
    input  wire       aRst_n,
    input  wire [23:0] vid_pData,  // [23:16] R (ch 2), [15:8] B (ch 0), [7:0] G (ch 1)
    input  wire       vid_pVDE,
    input  wire       vid_pHSync,
    input  wire       vid_pVSync,
    input  wire       PixelClk,
    input  wire       SerialClk,
    input  wire [31:0] ctrl,
    input  wire [31:0] fs_inc,
    input  wire [15:0] aud_l,
    input  wire [15:0] aud_r,
    input  wire       aud_valid
);
    // ---- reset: asynchronous assert, synchronous release (as rgb2dvi) -----
    (* ASYNC_REG = "TRUE" *) reg [1:0] rst_sync = 2'b11;
    always @(posedge PixelClk or negedge aRst_n)
        if (!aRst_n)
            rst_sync <= 2'b11;
        else
            rst_sync <= {rst_sync[0], 1'b0};
    wire rst = rst_sync[1];

    reg [31:0] ctrl_q = 0;
    always @(posedge PixelClk) ctrl_q <= ctrl;
    wire       hdmi_en  = ctrl_q[0];
    wire       audio_en = ctrl_q[0] & ctrl_q[1];
    wire       tone_en  = ctrl_q[2];
    wire [1:0] avi_sel  = ctrl_q[9:8];

    // ---- look-ahead delay line (SRLs) --------------------------------------
    reg [26:0] dly [0:LOOK-1];
    integer i;
    always @(posedge PixelClk) begin
        dly[0] <= {vid_pVDE, vid_pVSync, vid_pHSync, vid_pData};
        for (i = 1; i < LOOK; i = i + 1)
            dly[i] <= dly[i-1];
    end
    wire [26:0] d = dly[LOOK-1];
    wire        de_d = d[26], vs_d = d[25], hs_d = d[24];
    wire [23:0] rgb_d = d[23:0];

    // clocks until the delayed DE rises (LOOK when the undelayed DE rises now)
    reg de_u_q = 0;
    reg [4:0] vcnt = 0;
    always @(posedge PixelClk) de_u_q <= vid_pVDE;
    wire rise_u = vid_pVDE & ~de_u_q;
    wire [4:0] kk = rise_u ? LOOK[4:0] : vcnt;
    always @(posedge PixelClk) vcnt <= (kk != 0) ? kk - 5'd1 : 5'd0;
    wire vid_pre_0   = hdmi_en && !de_d && kk >= 5'd3 && kk <= 5'd10;
    wire vid_guard_0 = hdmi_en && !de_d && (kk == 5'd1 || kk == 5'd2);

    // ---- line measurement on the delayed stream ----------------------------
    reg        de_d_q = 0;
    // lc: clocks since the last HSYNC rising edge (line length measurement:
    //     HSYNC is on every line, also in the vertical blanking; either sync
    //     polarity gives the same period)
    // hc: position in the line from the DE rise; wraps at line_len, so it
    //     also runs through the lines of the vertical blanking
    reg [12:0] lc = 0, hc = 0, line_len = 0, act_w = 0;
    reg        tvalid = 0, hs_d_q = 0;
    wire rise_d = de_d & ~de_d_q, fall_d = ~de_d & de_d_q;
    wire hs_rise = hs_d & ~hs_d_q;
    wire [12:0] hc_n = rise_d ? 13'd0 : (hc == line_len - 13'd1) ? 13'd0 : hc + 13'd1;
    always @(posedge PixelClk) begin
        de_d_q <= de_d;
        hs_d_q <= hs_d;
        hc <= hc_n;
        lc <= hs_rise ? 13'd0 : (lc == 13'h1FFF) ? lc : lc + 13'd1;
        if (hs_rise) begin
            line_len <= lc + 13'd1;
            // valid after two equal lines in a row (mode changes, start-up)
            tvalid <= (lc + 13'd1 == line_len) && act_w != 0;
        end
        if (fall_d)
            act_w <= hc_n;
        if (rst) begin
            tvalid <= 1'b0;
            act_w <= 0;
        end
    end
    // packets per line: (blank - 30) / 32, max 18 (as hdl-util)
    wire [12:0] blank = line_len - act_w;
    reg  [4:0]  npk = 0;
    always @(posedge PixelClk)
        npk <= (!tvalid || blank < 13'd62) ? 5'd0 :
               ((blank - 13'd30) >> 5) > 13'd18 ? 5'd18 : (blank - 13'd30) >> 5;

    // data island: preamble p = 4..11, guard 12..13, packets 14.., guard 2
    wire        in_blank = !de_d && hc_n >= act_w;
    wire [12:0] p = hc_n - act_w;
    wire [12:0] di_end = 13'd14 + {npk, 5'd0};
    wire di_on = hdmi_en && npk != 0 && in_blank;
    wire di_pre_0    = di_on && p >= 13'd4 && p < 13'd12;
    wire di_period_0 = di_on && p >= 13'd14 && p < di_end;
    wire di_guard_0  = di_on && ((p >= 13'd12 && p < 13'd14) || (p >= di_end && p < di_end + 13'd2));
    wire pkt_en = di_period_0 && (p[4:0] == 5'd14);   // (p - 14) mod 32 == 0
    reg  vs_d_q = 0;
    always @(posedge PixelClk) vs_d_q <= vs_d;
    wire field_end = vs_d ^ vs_d_q;

    // ---- stage q: register the scheduler decisions (2026-10-27) ----------------
    // The position compares (line length -> hc -> p -> island windows -> packet
    // start) reached the packet picker in one clock (12.6 ns). This stage cuts
    // it; data and syncs get the same extra clock, so nothing moves.
    reg vid_pre_q = 0, vid_guard_q = 0, di_pre_q = 0, di_guard_q = 0, di_period_q = 0;
    reg pkt_en_q = 0, field_end_q = 0, de_q = 0, hs_q = 0, vs_q = 0;
    reg [23:0] rgb_q = 0;
    always @(posedge PixelClk) begin
        vid_pre_q <= vid_pre_0;  vid_guard_q <= vid_guard_0;
        di_pre_q <= di_pre_0;    di_guard_q <= di_guard_0;  di_period_q <= di_period_0;
        pkt_en_q <= pkt_en;      field_end_q <= field_end;
        de_q <= de_d;  hs_q <= hs_d;  vs_q <= vs_d;  rgb_q <= rgb_d;
    end

    // ---- stage 1 -------------------------------------------------------------
    reg vid_pre_1 = 0, vid_guard_1 = 0, di_pre_1 = 0, di_guard_1 = 0, di_period_1 = 0;
    reg de_1 = 0, hs_1 = 0, vs_1 = 0;
    reg [23:0] rgb_1 = 0;
    always @(posedge PixelClk) begin
        vid_pre_1 <= vid_pre_q;  vid_guard_1 <= vid_guard_q;
        di_pre_1 <= di_pre_q;    di_guard_1 <= di_guard_q;  di_period_1 <= di_period_q;
        de_1 <= de_q;  hs_1 <= hs_q;  vs_1 <= vs_q;  rgb_1 <= rgb_q;
    end

    // ---- audio source ----------------------------------------------------------
    reg [31:0] nco = 0;
    reg        nco_tick = 0;
    always @(posedge PixelClk) {nco_tick, nco} <= {1'b0, nco} + {1'b0, fs_inc};
    reg [4:0]  tone_cnt = 0;
    reg        tone_hi = 0;
    always @(posedge PixelClk)
        if (nco_tick) begin
            tone_cnt <= (tone_cnt == 5'd23) ? 5'd0 : tone_cnt + 5'd1;
            if (tone_cnt == 5'd23) tone_hi <= ~tone_hi;
        end
    wire [15:0] tone = tone_hi ? 16'h0800 : 16'hF800;
    wire        smp_valid = tone_en ? nco_tick : aud_valid;
    wire [15:0] smp_l = tone_en ? tone : aud_l;
    wire [15:0] smp_r = tone_en ? tone : aud_r;

    // ---- packets ---------------------------------------------------------------
    wire [8:0]  packet_data;
    hdmi_tx_packets packets (
        .clk(PixelClk), .rst(rst), .audio_en(audio_en), .avi_sel(avi_sel),
        .field_end(field_end_q), .pkt_en(pkt_en_q), .period(di_period_1),
        .smp_valid(smp_valid), .smp_l(smp_l), .smp_r(smp_r),
        .packet_data(packet_data));

    // ---- stage 2: mode and per-channel inputs ---------------------------------
    reg [2:0]  mode = 0;
    reg [23:0] video = 0;
    reg [5:0]  cdata = 0;     // {ch2 {C1,C0}, ch1 {C1,C0}, ch0 {VSYNC,HSYNC}}
    reg [11:0] idata = 0;     // TERC4 nibbles {ch2, ch1, ch0}
    always @(posedge PixelClk) begin
        mode <= di_guard_1 ? 3'd4 : di_period_1 ? 3'd3 : vid_guard_1 ? 3'd2 : de_1 ? 3'd1 : 3'd0;
        video <= rgb_1;
        // preambles: CTL0 = 1 (ch1 C0); data island preamble also CTL2 = 1 (ch2 C0)
        cdata <= {1'b0, di_pre_1, 1'b0, vid_pre_1 | di_pre_1, vs_1, hs_1};
        // channel 0: [3] = 1 inside the island (as hdl-util), [2] header bit, sync
        idata <= {packet_data[8:5], packet_data[4:1], 1'b1, packet_data[0], vs_1, hs_1};
    end

    // ---- TMDS encoders (rgb2dvi mapping: ch2 R, ch1 [7:0], ch0 [15:8]) --------
    wire [9:0] tmds0, tmds1, tmds2;
    hdmi_tx_encoder #(.CN(0)) enc0 (.clk(PixelClk), .mode(mode), .video(video[15:8]),
        .ctrl(cdata[1:0]), .terc4(idata[3:0]), .tmds(tmds0));
    hdmi_tx_encoder #(.CN(1)) enc1 (.clk(PixelClk), .mode(mode), .video(video[7:0]),
        .ctrl(cdata[3:2]), .terc4(idata[7:4]), .tmds(tmds1));
    hdmi_tx_encoder #(.CN(2)) enc2 (.clk(PixelClk), .mode(mode), .video(video[23:16]),
        .ctrl(cdata[5:4]), .terc4(idata[11:8]), .tmds(tmds2));

    // ---- serializers ------------------------------------------------------------
    hdmi_tx_serdes ser_clk (.PixelClk(PixelClk), .SerialClk(SerialClk), .rst(rst),
        .pdata(10'b1111100000), .out_p(TMDS_Clk_p), .out_n(TMDS_Clk_n));
    hdmi_tx_serdes ser_d0 (.PixelClk(PixelClk), .SerialClk(SerialClk), .rst(rst),
        .pdata(tmds0), .out_p(TMDS_Data_p[0]), .out_n(TMDS_Data_n[0]));
    hdmi_tx_serdes ser_d1 (.PixelClk(PixelClk), .SerialClk(SerialClk), .rst(rst),
        .pdata(tmds1), .out_p(TMDS_Data_p[1]), .out_n(TMDS_Data_n[1]));
    hdmi_tx_serdes ser_d2 (.PixelClk(PixelClk), .SerialClk(SerialClk), .rst(rst),
        .pdata(tmds2), .out_p(TMDS_Data_p[2]), .out_n(TMDS_Data_n[2]));
endmodule
